#define BLYNK_TEMPLATE_ID "TMPLvT7evAP3"
#define BLYNK_DEVICE_NAME "Blynk"
#define BLYNK_AUTH_TOKEN "5iXYo8D2VpHQ0q84BLAF8JRL7YgKLBb6"

#define BLYNK_PRINT Serial

#include <WiFi.h>
#include <WiFiClient.h>
#include <BlynkSimpleEsp32.h>

char auth[] = BLYNK_AUTH_TOKEN;
char ssid[] = "Chandra";
char pass[] = "passw0rd@22";

#include <Wire.h>
#include <Adafruit_Sensor.h>
#include <Adafruit_BME280.h>
#include <Adafruit_GFX.h>
#include <Adafruit_SH110X.h>

#define SCREEN_WIDTH 128 // OLED display width, in pixels
#define SCREEN_HEIGHT 64 // OLED display height, in pixels

#define OLED_RESET -1 // Reset pin # (or -1 if sharing Arduino reset pin)
Adafruit_SH1106G display(SCREEN_WIDTH, SCREEN_HEIGHT, &Wire, OLED_RESET); // Declaration for an SH1106 display connected to I2C (SDA, SCL pins)

// 'Air Quality', 128x64px
const unsigned char splash [] PROGMEM =
{
  0x00, 0x00, 0x00, 0x00, 0x00, 0x00, 0x00, 0x00, 0x00, 0x00, 0x00, 0x00, 0x00, 0x00, 0x00, 0x00,
  0x00, 0x00, 0x00, 0x00, 0x00, 0x00, 0x00, 0x00, 0x00, 0x00, 0x00, 0x00, 0x00, 0x00, 0x00, 0x00,
  0x00, 0x00, 0x00, 0x00, 0x00, 0x00, 0x00, 0x00, 0x00, 0x00, 0x00, 0x00, 0x00, 0x00, 0x00, 0x00,
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  0x00, 0x00, 0x00, 0x00, 0x00, 0x00, 0x00, 0x00, 0x00, 0x00, 0x00, 0x00, 0x00, 0x00, 0x00, 0x00
};

int CO2Sensor = 36;

Adafruit_BME280 bme;

int temp = 0;
int humid = 0;
int pressure = 0;
int CO2 = 0;
BlynkTimer timer;


#define MQ2 34
#define GREEN 16
#define RED 17
#define buzzer  13
int MQ2_Val = 0;

void setup() //Setup function - only function that is run in deep sleep mode
{
  Serial.begin(9600); //Start the serial output at 115,200 baud
  pinMode(GREEN, OUTPUT);
  pinMode(RED, OUTPUT);
  pinMode(buzzer, OUTPUT);
  
  analogReadResolution(10); //Set the resolution of the analogue input
  if (!display.begin(0x3C)) //Connect to the OLED display
  {
    Serial.println(F("SH1106 allocation failed")); //If connection fails
    for (;;); //Don't proceed, loop forever
  }
  display.clearDisplay(); //Clear the display
  display.setTextColor(SH110X_WHITE); //Set the text colour to white
  display.drawBitmap(0, 0, splash, 128, 64, SH110X_WHITE); //Display bitmap from array
  display.setTextSize(1); //Set the text size
  display.setCursor(30, 50);
  display.print(F("Air Quality"));
  display.display();

  unsigned status;
  status = bme.begin(); //Connect to BME sensor
  if (!status)
  {
    Serial.println("Could not find a valid BME280 sensor");
  }
  delay(2000);
  Blynk.begin(auth, ssid, pass);//Splash screen delay
  delay(2000);
  timer.setInterval(1000L, mySensor);
}

void loop() //Loop function
{
  Blynk.run();
  timer.run();
}

void mySensor()
{

  recTemp ();
  recHumid ();
  recPress ();
  recCO2 ();
  mq2_data();
  Blynk.virtualWrite(V0, temp);
  Blynk.virtualWrite(V1, humid);
  Blynk.virtualWrite(V2, pressure);
  Blynk.virtualWrite(V3, CO2);
  Blynk.virtualWrite(V4, MQ2_Val);
  
  Serial.print("Temp: ");
  Serial.println(temp);
  Serial.print("Humidity: ");
  Serial.println(humid);
  Serial.print("Pressure: ");
  Serial.println(pressure);
  Serial.print("CO2: ");
  if (CO2 >= 0)
  {
    Serial.println(CO2);
  }
  else
  {
    Serial.println("Preheating");
  }
  display.clearDisplay(); //Clear display
  display.setCursor(32, 4);
  display.print(F("Air Quality"));
  display.setCursor(15, 18); //Set the display cursor position
  display.print(F("Temp: ")); //Set the display text
  display.setCursor(60, 18);
  display.print(temp);
  display.print(F(" C"));
  display.setCursor(15, 30);
  display.print(F("Humid: "));
  display.setCursor(60, 30);
  display.print(humid);
  display.print(F(" %"));
  display.setCursor(15, 42);
  display.print(F("Press: "));
  display.setCursor(60, 42);
  display.print(pressure);
  display.print(F(" hPa"));
  display.setCursor(15, 54);
  display.print(F("CO2: "));
  display.setCursor(60, 54);
  display.print(CO2);
  display.setCursor(15, 70);
  display.print(F("MQ2: "));
  display.setCursor(60, 70);
  display.print(MQ2_Val);
  display.print(F(" ppm"));
//   if (CO2 >= 0)
//   {
//     display.print(CO2);
//     display.print(F(" ppm"));
//   }
//   else
//   {
//     display.print(F("Preheating"));
//   }
  display.display(); //Output the display text
}

void recTemp () //Function to record the temperature
{
  temp = bme.readTemperature();
}

void recHumid () //Function to record the humidity
{
  humid = bme.readHumidity();
  if (humid > 100)
    humid = 100;
}

void recPress () //Function to record the pressure
{
  pressure = bme.readPressure() / 100;
}

void recCO2 ()
{
  int sensorValue = analogRead(CO2Sensor);
  Serial.print("Sensor Reading: ");
  Serial.println(sensorValue);
  float voltage = sensorValue * (3300 / 1023) + 154;
  Serial.print("Voltage: ");
  Serial.println(voltage);
  CO2 = (voltage - 400) * 50 / 16;
//   if (voltage < 400)
//   {
//     CO2 = -1;
//   }
//   else
//   {
//     CO2 = (voltage - 400) * 50 / 16;
//   }
}

void mq2_data()
{
  MQ2_Val = analogRead(MQ2);
    
  if (MQ2_Val > 600)
  {
    Blynk.notify("Gas Detected!");
    digitalWrite(GREEN, LOW);
    digitalWrite(RED, HIGH);
    digitalWrite(buzzer, HIGH);

  }

  else
  {
    digitalWrite(GREEN, HIGH);
    digitalWrite(RED, LOW);
    digitalWrite(buzzer, LOW);
  }
}
